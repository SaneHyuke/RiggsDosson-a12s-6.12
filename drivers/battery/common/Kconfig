## drivers/battery/common/Kconfig
```kconfig
# Samsung battery configuration

menu "Samsung battery support"

config BATTERY_SAMSUNG
	tristate "Samsung battery driver"
	help
	  Include the Samsung integrated battery driver. Optional charger,
	  fuel gauge, MUIC and PDIC integrations are configured separately.

config BATTERY_SAMSUNG_LEGO_STYLE
	tristate "Samsung battery driver (LEGO style)"
	default n
	depends on BATTERY_SAMSUNG
	help
	  Enable the LEGO-style Samsung battery driver implementation.

config BATTERY_CISD
	bool "Samsung battery CISD support"
	help
	  Enable cell internal short detection and battery event accounting.

endmenu
```

## drivers/input/touchscreen/ili9881x/Kconfig
```kconfig
#
# Ilitek ili9881x touchscreen driver configuration
#
menuconfig TOUCHSCREEN_ILITEK_ILI9881X
	bool "Ilitek ili9881x touchscreen"
	select INPUT_SEC_CMD
	help
	  Say Y here if you have an Ilitek ILI9881x touchscreen connected
	  to your system.

	  If unsure, say N.

if TOUCHSCREEN_ILITEK_ILI9881X

config TOUCHSCREEN_ILITEK_ILI9881X_SPI
	bool "SPI"
	depends on SPI_MASTER
endif
```

## drivers/video/fbdev/exynos/Kconfig
```kconfig
# SPDX-License-Identifier: GPL-2.0-only

config EXYNOS_DPU30_3830
	bool

config EXYNOS_DPU30
	bool "Samsung Exynos DPU30 display support"
	depends on FB && ARCH_EXYNOS && MEDIA_SUPPORT
	select EXYNOS_DPU30_3830
	select EXYNOS_MIPI_DSIM
	select MEDIA_CONTROLLER
	select SAMSUNG_IOMMU
	select PHY_EXYNOS_MIPI_DSIM
	select VIDEO_DEV
	select VIDEO_V4L2_SUBDEV_API

config EXYNOS_DPP
	bool
	default y if EXYNOS_DPU30

config EXYNOS_MIPI_DSIM
	bool
	default y if EXYNOS_DPU30

config EXYNOS_COMMON_PANEL
	bool "Exynos common panel driver"
	depends on EXYNOS_DPU30
	select BACKLIGHT_CLASS_DEVICE
	default y

config PANEL_AID_DIMMING
	bool
	default y if EXYNOS_COMMON_PANEL

config EXYNOS_DECON_LCD_NT36525B_CTC_A12S
	bool "NT36525B CTC A12S LCD driver"
	depends on EXYNOS_DPU30 && EXYNOS_COMMON_PANEL
	select SUPPORT_I2C
	default y

config SUPPORT_I2C
	bool "LCD I2C support"
	depends on I2C
	default y if EXYNOS_DECON_LCD_NT36525B_CTC_A12S
```
